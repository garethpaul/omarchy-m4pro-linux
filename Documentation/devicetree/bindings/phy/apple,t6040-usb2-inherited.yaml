## Documentation/devicetree/bindings/phy/apple,t6040-usb2-inherited.yaml
```yaml
# SPDX-License-Identifier: (GPL-2.0-only OR BSD-2-Clause)
%YAML 1.2
---
$id: http://devicetree.org/schemas/phy/apple,t6040-usb2-inherited.yaml#
$schema: http://devicetree.org/meta-schemas/core.yaml#

title: J614s/J616s inherited USB2 device PHY for RAM experiments

maintainers:
  - Sven Peter <sven@kernel.org>

description: |
  Admission for the USB2 device-mode state prepared by m1n1 on J614s USB1
  or J616s USB0.
  The J614s profile additionally requires the exact USB1 PHY/PIPE apertures.
  The provider reads its USB2/PIPE state and performs no power, reset or
  calibration writes. Its caller owns controller/DART handoff and must retain
  the bootloader's PHY clocks and physical watchdog until cold recovery.

  J616s USB0 references SID 0 at DART 0x382f00000 and SID 1 at
  DART 0x382f80000, sharing fault interrupt 1623. J614s USB1 references
  SID 0 at DART 0x38af00000 and SID 1 at DART 0x38af80000, sharing fault
  interrupt 1655. Each pair uses the same DMA aperture. The native handoff uses the low 32-bit
  aperture, from zero through 0xffffffff, for both providers. The caller must
  transfer both banks before either ordinary DART driver probe; an idle state
  snapshot does not establish exclusive ownership.

  On J614s USB1, generic serial bulk transfers were observed with both
  snps,dis_u2_susphy_quirk and snps,dis_enblslpm_quirk on the consumer.
  These properties retain the working bootloader USB2 low-power settings.
  Their individual necessity was not isolated.

  Notification-suppressed USB2 bulk device operation has been observed with
  this two-bank model. Normal ACM notifications remain unqualified, and this
  does not describe complete T6040 Type-C, host or SuperSpeed support.

properties:
  compatible:
    const: apple,t6040-usb2-inherited

  reg:
    minItems: 2
    maxItems: 2

  reg-names:
    items:
      - const: usb2phy
      - const: pipehandler

  '#phy-cells':
    const: 0

  apple,inherited-handoff:
    type: boolean
    description: |
      The bootloader has retired its DWC3 consumers, transferred DMA ownership
      of both USB DART banks and retained initialized USB2 PHY clocks and a
      physical watchdog. This assertion does not perform those operations.

required:
  - compatible
  - reg
  - reg-names
  - '#phy-cells'
  - apple,inherited-handoff

additionalProperties: false
```

## drivers/gpu/drm/asahi/Kconfig
```kconfig
# SPDX-License-Identifier: GPL-2.0

config RUST_DRM_SCHED
	bool
	select DRM_SCHED

config RUST_DRM_GPUVM
	bool
	select DRM_GPUVM

config DRM_ASAHI
	tristate "Asahi (DRM support for Apple AGX GPUs)"
	depends on RUST
	depends on DRM=y
	depends on (ARM64 && ARCH_APPLE) || (COMPILE_TEST && !GENERIC_ATOMIC64)
	depends on MMU
	depends on IOMMU_SUPPORT
	depends on PAGE_SIZE_16KB
	select APPLE_PMP_REPORT
	select RUST_DRM_SCHED
	select RUST_DRM_GEM_SHMEM_HELPER
	select RUST_DRM_GPUVM
	select RUST_APPLE_RTKIT
	select WANT_DEV_COREDUMP
	help
	  DRM driver for Apple AGX GPUs (G13x, found in the M1 SoC family)

config DRM_ASAHI_DEBUG_ALLOCATOR
	bool "Use debug allocator"
	depends on DRM_ASAHI
	help
	  Use an alternate, simpler allocator which significantly reduces
	  performance, but can help find firmware- or GPU-side memory safety
	  issues. However, it can also trigger firmware bugs more easily,
	  so expect GPU crashes.

	  Say N unless you are debugging firmware structures or porting to a
	  new firmware version.

config DRM_ASAHI_G16_BOOTSTRAP
	tristate "J614s G16S RTKit bootstrap qualification"
	depends on ARM64 && ARCH_APPLE && APPLE_RTKIT
	help
	  Experimental cold-start qualification for the measured J614s M4 Pro
	  and 25G83 G16S B-silicon firmware. This creates no DRM render node.
	  Power and firmware reservations must be supplied by the test loader.
```
